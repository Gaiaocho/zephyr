## drivers/sensor/st/lis3dshtr/Kconfig
```kconfig
# Copyright (c) 2025, gaiaochos.com
# SPDX-License-Identifier: Apache 2.0

config LIS3DSHTR
	bool "ST LIS3DSHTR 3 Axis Accelerometer"
	default y
	select SPI
	depends on DT_HAS_ST_LIS3DSHTR_ENABLED
	help
	  Enable driver for the LI3DSHTR SPI based accelemetor
	  with a temperature sensor.


config LISDSHTR_INIT_PRIORITY
	int "SC18IS606 SPI init priority"
	default 199
	help
	  SC18IS606 SPI controller initialization priority

	  Note: Has to be greater than the I2C initialization priority.
```
