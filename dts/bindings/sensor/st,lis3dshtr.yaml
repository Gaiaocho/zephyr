## dts/bindings/sensor/st,lis3dshtr.yaml
```yaml
# Copyright (c) 2025 gaiaochos.com
# SPDX-License-Identifier: Apache 2.0

description: |
  STMicroelectronics LIS3DSHTR 3-axis accelerometer accessed via SPI

compatible: "st,lis3dshtr"

include: spi-device.yaml
```
